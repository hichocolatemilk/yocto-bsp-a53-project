## meta-custom-a53/conf/distro/custom-a53.conf
```bitbake
require conf/distro/poky.conf
DISTRO = "custom-a53"
DISTRO_NAME = "Custom A53 Distro"
DISTRO_VERSION = "1.0"
LICENSE_FLAGS_ACCEPTED = "synaptics-killswitch"


RPI_USE_U_BOOT = "1"
ENABLE_UART = "1"
UBOOT_DELAY = "5"

DISTRO_FEATURES:append = " systemd usrmerge u-boot"
DISTRO_FEATURES_BACKFILL_CONSIDERED = "sysvinit"

VIRTUAL-RUNTIME_init_manager = "systemd"
VIRTUAL-RUNTIME_initscripts = ""
```

## meta-custom-a53/conf/layer.conf
```bitbake
BBPATH .= ":${LAYERDIR}"

BBFILES += "${LAYERDIR}/recipes-*/*/*.bb \
            ${LAYERDIR}/recipes-*/*/*.bbappend"

BBFILE_COLLECTIONS += "customa53"
BBFILE_PATTERN_customa53 := "^${LAYERDIR}/"
BBFILE_PRIORITY_customa53 = "12"

LAYERSERIES_COMPAT_customa53 = "scarthgap"
```

## meta-custom-a53/conf/machine/custom-a53-6.12.conf
```bitbake
require conf/machine/raspberrypi3-64.conf
PREFERRED_VERSION_linux-raspberrypi = "6.12.%"
KBUILD_DEFCONFIG:custom-a53 = "bcm2711_defconfig"
IMAGE_ROOTFS_EXTRA_SPACE = "4194304"
```

## meta-custom-a53/conf/machine/custom-a53-6.6.conf
```bitbake
require conf/machine/raspberrypi3-64.conf
KBUILD_DEFCONFIG:custom-a53 = "bcm2711_defconfig"
#KB
IMAGE_ROOTFS_EXTRA_SPACE = "4194304"
```
